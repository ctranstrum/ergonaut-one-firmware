## config/boards/shields/dongle_oled/Kconfig.shield
```kconfig
# Copyright (c) 2024 The ZMK Contributors
# SPDX-License-Identifier: MIT

config SHIELD_DONGLE_OLED
	def_bool $(shields_list_contains,dongle_oled)
```

## config/boards/shields/ergonaut_one/Kconfig.defconfig
```kconfig
# Copyright (c) 2020 The ZMK Contributors
# SPDX-License-Identifier: MIT

if SHIELD_ERGONAUT_ONE_DONGLE

config ZMK_KEYBOARD_NAME
	default "Ergonaut One"

config ZMK_SPLIT_ROLE_CENTRAL
	default y

config ZMK_USB
        default y

endif

if SHIELD_ERGONAUT_ONE_DONGLE || SHIELD_ERGONAUT_ONE_LEFT || SHIELD_ERGONAUT_ONE_RIGHT

config ZMK_SPLIT
	default y

config ZMK_BLE
        default y

endif
```
